## config/west.yml
```yaml
manifest:
  remotes:
    - name: zmkfirmware
      url-base: https://github.com/zmkfirmware
    - name: okke-formsma
      url-base: https://github.com/okke-formsma/zmk.git
  projects:
    - name: zmk
      remote: okke-formsma
      revision: bugfix-stuck-keys
      import: app/west.yml
  self:
    path: config
```
